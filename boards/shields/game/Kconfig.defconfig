## boards/shields/game/Kconfig.defconfig
```kconfig
# Copyright (c) 2020 The ZMK Contributors
# SPDX-License-Identifier: MIT

if SHIELD_GAME

config ZMK_KEYBOARD_NAME
    default "GAME"

endif
```

## config/west.yml
```yaml
manifest:
  remotes:
   - name: felixm12138
     url-base: https://github.com/felixm12138
  projects:
   - name: zmk
     remote: felixm12138
     revision: main
     import: app/west.yml
  self:
    path: config
```
